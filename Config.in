## Config.in
```kconfig
source "$BR2_EXTERNAL_KED_PATH/package/dx-npu-driver/Config.in"
source "$BR2_EXTERNAL_KED_PATH/package/dx-rt/Config.in"
source "$BR2_EXTERNAL_KED_PATH/package/dx-fw/Config.in"
source "$BR2_EXTERNAL_KED_PATH/package/dx-stream/Config.in"
source "$BR2_EXTERNAL_KED_PATH/package/librdkafka/Config.in"
source "$BR2_EXTERNAL_KED_PATH/package/ked-libyuv/Config.in"
source "$BR2_EXTERNAL_KED_PATH/package/dxpose-qt/Config.in"
```

## package/dx-fw/Config.in
```kconfig
config BR2_PACKAGE_DX_FW
	bool "dx-fw"
	help
	  Firmware DeepX per NPU DX-M1/DX-M1M (v2.5.6). Installa i fw.bin
	  di tutte le varianti in /lib/firmware/deepx/. L'aggiornamento del
	  modulo si esegue una tantum (poi power cycle) con:
	    dxrt-cli -g /lib/firmware/deepx/m1/2.5.6/mdot2/fw.bin  (legge la versione)
	    dxrt-cli -u /lib/firmware/deepx/m1/2.5.6/mdot2/fw.bin  (aggiorna)
	  dx_rt 3.3.2 richiede firmware >= 2.5.2.
```

## package/dx-npu-driver/Config.in
```kconfig
config BR2_PACKAGE_DX_NPU_DRIVER
	bool "dx-npu-driver"
	depends on BR2_LINUX_KERNEL
	help
	  DeepX DX-M1 NPU Linux kernel driver (dxrt_driver + dx_dma,
	  variante PCIe DeepX). Sorgente: DEEPX-AI/dx_rt_npu_linux_driver.

comment "dx-npu-driver needs a Linux kernel to be built"
	depends on !BR2_LINUX_KERNEL
```

## package/dx-rt/Config.in
```kconfig
config BR2_PACKAGE_DX_RT
	bool "dx-rt"
	depends on BR2_INSTALL_LIBSTDCPP
	depends on BR2_TOOLCHAIN_HAS_THREADS
	select BR2_PACKAGE_NCURSES
	help
	  DeepX Runtime SDK (libdxrt, dxrtd, dxrt-cli, run_model, dxtop)
	  per NPU DX-M1. Sorgente: DEEPX-AI/dx_rt v3.3.2. Build senza
	  ONNXRuntime e senza binding Python (vedi .mk per riabilitarli).

comment "dx-rt needs a toolchain w/ C++, threads"
	depends on !BR2_INSTALL_LIBSTDCPP || !BR2_TOOLCHAIN_HAS_THREADS
```

## package/dx-stream/Config.in
```kconfig
config BR2_PACKAGE_DX_STREAM
	bool "dx-stream"
	depends on BR2_PACKAGE_DX_RT
	depends on BR2_INSTALL_LIBSTDCPP
	select BR2_PACKAGE_GSTREAMER1
	select BR2_PACKAGE_GST1_PLUGINS_BASE
	select BR2_PACKAGE_EIGEN
	select BR2_PACKAGE_JSON_GLIB
	select BR2_PACKAGE_ZLIB
	select BR2_PACKAGE_OPENCV4
	select BR2_PACKAGE_KED_LIBYUV
	select BR2_PACKAGE_MOSQUITTO
	select BR2_PACKAGE_LIBRDKAFKA
	help
	  DeepX DX-Stream (v3.0.1): suite di plugin GStreamer per pipeline
	  di inferenza su DX-M1 (dxinfer, dxconvert, dxosd, dxgather, ...).
	  In modalita' accelerator richiede anche mosquitto e librdkafka
	  (broker di messaggi per i metadati).

comment "dx-stream needs dx-rt and a toolchain w/ C++"
	depends on !BR2_PACKAGE_DX_RT || !BR2_INSTALL_LIBSTDCPP
```

## package/dxpose-qt/Config.in
```kconfig
config BR2_PACKAGE_DXPOSE_QT
	bool "dxpose-qt"
	depends on BR2_PACKAGE_QT6
	depends on BR2_TOOLCHAIN_HAS_THREADS
	depends on BR2_INSTALL_LIBSTDCPP
	select BR2_PACKAGE_QT6BASE
	select BR2_PACKAGE_QT6BASE_WIDGETS
	select BR2_PACKAGE_QT6BASE_GUI
	select BR2_PACKAGE_QT6BASE_NETWORK
	select BR2_PACKAGE_GSTREAMER1
	select BR2_PACKAGE_GST1_PLUGINS_BASE
	select BR2_PACKAGE_GST1_PLUGINS_BASE_PLUGIN_APP
	select BR2_PACKAGE_GST1_PLUGINS_BASE_PLUGIN_VIDEOCONVERTSCALE
	select BR2_PACKAGE_GST1_PLUGINS_GOOD
	select BR2_PACKAGE_GST1_PLUGINS_GOOD_PLUGIN_V4L2
	select BR2_PACKAGE_GST1_PLUGINS_BAD
	# y4mdec (gst-plugins-bad, plugin y4m): decodifica del video di fallback
	select BR2_PACKAGE_GST1_PLUGINS_BAD_PLUGIN_Y4M
	help
	  Visualizzatore Qt6/GStreamer per la catena video IMX219 in PL
	  con inferenza sull'acceleratore DeepX DX-M1.

	  - configura nativamente la pipeline media (demosaic/CSC/gamma/VPSS)
	  - selezione manuale del modello .dxnn, fallback su file video
	  - controlli ISP live + auto white balance gray-world
	  - telemetria INA226 e DX-M1

	  Richiede a runtime dx-stream (elementi dxpreprocess/dxinfer/...)
	  e i modelli .dxnn in /home/ked/models.

comment "dxpose-qt needs Qt6 and a toolchain w/ threads, C++"
	depends on !BR2_PACKAGE_QT6 || !BR2_TOOLCHAIN_HAS_THREADS || !BR2_INSTALL_LIBSTDCPP
```

## package/ked-libyuv/Config.in
```kconfig
config BR2_PACKAGE_KED_LIBYUV
	bool "ked-libyuv"
	depends on BR2_INSTALL_LIBSTDCPP
	select BR2_PACKAGE_JPEG
	help
	  libyuv recente (snapshot upstream) al posto del pacchetto
	  Buildroot in-tree, la cui versione non include NV12Scale
	  richiesta da dx-stream. Non abilitare insieme a
	  BR2_PACKAGE_LIBYUV.
```

## package/librdkafka/Config.in
```kconfig
config BR2_PACKAGE_LIBRDKAFKA
	bool "librdkafka"
	depends on BR2_TOOLCHAIN_HAS_THREADS
	select BR2_PACKAGE_ZLIB
	select BR2_PACKAGE_OPENSSL
	help
	  The Apache Kafka C/C++ client library.
	  Richiesta da dx-stream (broker metadati) in modalita' accelerator.

	  https://github.com/confluentinc/librdkafka

comment "librdkafka needs a toolchain w/ threads"
	depends on !BR2_TOOLCHAIN_HAS_THREADS
```
